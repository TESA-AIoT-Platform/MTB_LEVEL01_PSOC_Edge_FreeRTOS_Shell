// This file is automatically generated.
// define memory with size = 4G;
define region code_1 = [from 0x60100400 size 0x0003FB00];
define region code_1_C = [from 0x08100400 size 0x0003FB00];
define region codeNsc = [from 0x6013FF00 size 0x00000100];
define region codeNsc_C = [from 0x0813FF00 size 0x00000100];
define region code_1_ns = [from 0x60340400 size 0x001FFC00];
define region code_1_ns_C = [from 0x08340400 size 0x001FFC00];
define region gpu_buf = [from 0x26080000 size 0x00080000];
define region gpu_buf_C = [from 0x06080000 size 0x00080000];
define region shared_mem1_ns = [from 0x26100000 size 0x00100000];
define region shared_mem1_ns_C = [from 0x06100000 size 0x00100000];
define region code_5_ns = [from 0x26300000 size 0x00100000];
define region code_5_ns_C = [from 0x06300000 size 0x00100000];
define region data_3_ns = [from 0x26400000 size 0x00100000];
define region data_3_ns_C = [from 0x06400000 size 0x00100000];
define region code_2 = [from 0x24001000 size 0x00007000];
define region code_2_C = [from 0x04001000 size 0x00007000];
define region data_2_ns = [from 0x24055000 size 0x0002B000];
define region data_2_ns_C = [from 0x04055000 size 0x0002B000];
define region code_4_ns = [from 0x24080000 size 0x00040000];
define region code_4_ns_C = [from 0x04080000 size 0x00040000];
define region data_1_ns = [from 0x240C0000 size 0x0003E000];
define region data_1_ns_C = [from 0x040C0000 size 0x0003E000];
define region shared_mem0_ns = [from 0x240FE800 size 0x00000800];
define region shared_mem0_ns_C = [from 0x040FE800 size 0x00000800];
