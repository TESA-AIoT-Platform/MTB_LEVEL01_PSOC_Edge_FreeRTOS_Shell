// This file is automatically generated.
// define memory with size = 4G;
define region code_8 = [from 0x2200F400 size 0x0001AB00];
define region code_8_C = [from 0x0200F400 size 0x0001AB00];
define region code_8_C_S = [from 0x1200F400 size 0x0001AB00];
define region code_8_S = [from 0x3200F400 size 0x0001AB00];
define region code_1 = [from 0x60100400 size 0x0003FB00];
define region code_1_C = [from 0x08100400 size 0x0003FB00];
define region code_1_C_S = [from 0x18100400 size 0x0003FB00];
define region code_1_S = [from 0x70100400 size 0x0003FB00];
define region codeNsc = [from 0x6013FF00 size 0x00000100];
define region codeNsc_C = [from 0x0813FF00 size 0x00000100];
define region codeNsc_C_S = [from 0x1813FF00 size 0x00000100];
define region codeNsc_S = [from 0x7013FF00 size 0x00000100];
define region code_2 = [from 0x24001000 size 0x00007000];
define region code_2_C = [from 0x04001000 size 0x00007000];
define region code_2_C_S = [from 0x14001000 size 0x00007000];
define region code_2_S = [from 0x34001000 size 0x00007000];
define region data_1 = [from 0x24008000 size 0x0004B000];
define region data_1_C = [from 0x04008000 size 0x0004B000];
define region data_1_C_S = [from 0x14008000 size 0x0004B000];
define region data_1_S = [from 0x34008000 size 0x0004B000];
define region shared_mem0 = [from 0x24054000 size 0x00001000];
define region shared_mem0_C = [from 0x04054000 size 0x00001000];
define region shared_mem0_C_S = [from 0x14054000 size 0x00001000];
define region shared_mem0_S = [from 0x34054000 size 0x00001000];
define region shared_mem1 = [from 0x240FE000 size 0x00000800];
define region shared_mem1_C = [from 0x040FE000 size 0x00000800];
define region shared_mem1_C_S = [from 0x140FE000 size 0x00000800];
define region shared_mem1_S = [from 0x340FE000 size 0x00000800];
