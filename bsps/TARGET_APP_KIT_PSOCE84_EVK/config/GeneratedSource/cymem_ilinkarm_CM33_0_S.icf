// This file is automatically generated.
define exported symbol CYMEM_CM33_0_S_code_8_START = 0x2200F400;
define exported symbol CYMEM_CM33_0_S_code_8_C_START = 0x0200F400;
define exported symbol CYMEM_CM33_0_S_code_8_C_S_START = 0x1200F400;
define exported symbol CYMEM_CM33_0_S_code_8_S_START = 0x3200F400;
define exported symbol CYMEM_CM33_0_S_code_8_SIZE = 0x0001AB00;
define exported symbol CYMEM_CM33_0_S_code_1_START = 0x60100400;
define exported symbol CYMEM_CM33_0_S_code_1_C_START = 0x08100400;
define exported symbol CYMEM_CM33_0_S_code_1_C_S_START = 0x18100400;
define exported symbol CYMEM_CM33_0_S_code_1_S_START = 0x70100400;
define exported symbol CYMEM_CM33_0_S_code_1_SIZE = 0x0003FB00;
define exported symbol CYMEM_CM33_0_S_codeNsc_START = 0x6013FF00;
define exported symbol CYMEM_CM33_0_S_codeNsc_C_START = 0x0813FF00;
define exported symbol CYMEM_CM33_0_S_codeNsc_C_S_START = 0x1813FF00;
define exported symbol CYMEM_CM33_0_S_codeNsc_S_START = 0x7013FF00;
define exported symbol CYMEM_CM33_0_S_codeNsc_SIZE = 0x00000100;
define exported symbol CYMEM_CM33_0_S_code_2_START = 0x24001000;
define exported symbol CYMEM_CM33_0_S_code_2_C_START = 0x04001000;
define exported symbol CYMEM_CM33_0_S_code_2_C_S_START = 0x14001000;
define exported symbol CYMEM_CM33_0_S_code_2_S_START = 0x34001000;
define exported symbol CYMEM_CM33_0_S_code_2_SIZE = 0x00007000;
define exported symbol CYMEM_CM33_0_S_data_1_START = 0x24008000;
define exported symbol CYMEM_CM33_0_S_data_1_C_START = 0x04008000;
define exported symbol CYMEM_CM33_0_S_data_1_C_S_START = 0x14008000;
define exported symbol CYMEM_CM33_0_S_data_1_S_START = 0x34008000;
define exported symbol CYMEM_CM33_0_S_data_1_SIZE = 0x0004B000;
define exported symbol CYMEM_CM33_0_S_shared_mem0_START = 0x24054000;
define exported symbol CYMEM_CM33_0_S_shared_mem0_C_START = 0x04054000;
define exported symbol CYMEM_CM33_0_S_shared_mem0_C_S_START = 0x14054000;
define exported symbol CYMEM_CM33_0_S_shared_mem0_S_START = 0x34054000;
define exported symbol CYMEM_CM33_0_S_shared_mem0_SIZE = 0x00001000;
define exported symbol CYMEM_CM33_0_S_shared_mem1_START = 0x240FE000;
define exported symbol CYMEM_CM33_0_S_shared_mem1_C_START = 0x040FE000;
define exported symbol CYMEM_CM33_0_S_shared_mem1_C_S_START = 0x140FE000;
define exported symbol CYMEM_CM33_0_S_shared_mem1_S_START = 0x340FE000;
define exported symbol CYMEM_CM33_0_S_shared_mem1_SIZE = 0x00000800;
