// This file is automatically generated.
// define memory with size = 4G;
define region data_2 = [from 0x48040000 size 0x00040000];
define region data_2_INTERNAL = [from 0x20000000 size 0x00040000];
define region code_4 = [from 0x48000000 size 0x00040000];
define region code_4_INTERNAL = [from 0x00000000 size 0x00040000];
define region code_3 = [from 0x60580400 size 0x002FFC00];
define region code_6 = [from 0x26000000 size 0x00080000];
define region gpu_buf = [from 0x26080000 size 0x00080000];
define region shared_mem1_ns = [from 0x26100000 size 0x00100000];
define region data_3 = [from 0x26200000 size 0x00100000];
define region shared_mem2 = [from 0x240FF000 size 0x00001000];
